## drivers/input/fingerprint/Kconfig
```kconfig
config INPUT_FINGERPRINT
	tristate "Fingerprint driver support"
	help
	  Say Y here to enable fingerprint driver support

source "drivers/input/fingerprint/common/Kconfig"
source "drivers/input/fingerprint/ysl/Kconfig"
```

## drivers/input/fingerprint/common/Kconfig
```kconfig
source "drivers/input/fingerprint/common/fpc/Kconfig"
source "drivers/input/fingerprint/common/goodix/Kconfig"
```

## drivers/input/fingerprint/ysl/Kconfig
```kconfig
source "drivers/input/fingerprint/ysl/fpc/Kconfig"
source "drivers/input/fingerprint/ysl/goodix/Kconfig"
```
